## conf/layer.conf
```bitbake
# We have a conf and classes directory, add to BBPATH
BBPATH .= ":${LAYERDIR}"

# We have recipes-* directories, add to BBFILES
BBFILES += "${LAYERDIR}/recipes-*/*/*.bb \
            ${LAYERDIR}/recipes-*/*/*.bbappend"

BBFILE_COLLECTIONS += "meta-fit"
BBFILE_PATTERN_meta-fit = "^${LAYERDIR}/"
BBFILE_PRIORITY_meta-fit = "6"

#LAYERDEPENDS_fit = "meta-freescale-3rdparty"
#LAYERVERSION_fit = "1"
```

## conf/machine/wandboard-custom.conf
```bitbake
#@TYPE: Machine
#@NAME: Wandboard i.MX6 Wandboard Quad Mein machine
#@SOC: i.MX6Q
#@DESCRIPTION: Custom Machine configuration for i.MX6 Wandboard Quad
#@MAINTAINER:

require conf/machine/wandboard.conf

#UBOOT_MACHINE = "wandboard-custom_defconfig"

UBOOT_EXTLINUX_KERNEL_ARGS += "video=mxcfb0:dev=hdmi,1920x1080M@60,if=RGB24"

# TODO: see..
#   meta-freescale-3rdparty/conf/machine/wandboard.conf
#   meta-freescale-3rdparty/recipes-bsp/broadcom-nvram-config/*
#   note: fw and nvram files are in ~/wifi_firmware/rockchip
#MACHINE_EXTRA_RRECOMMENDS += " \
#  bcm4339-nvram-config \
#"

MACHINE_ESSENTIAL_EXTRA_RDEPENDS += " \
    kernel-module-bcmdhd \
"

IMAGE_FSTYPES += "wic.gz tar.bz2"

# TODO: is this needed ?
#KERNEL_DEVICETREE = "imx6qp-wandboard-custom-revd1.dtb"
```
